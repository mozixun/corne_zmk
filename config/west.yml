## config/west.yml
```yaml
manifest:
  remotes:
    - name: zmkfirmware
      url-base: https://github.com/zmkfirmware
    - name: mozixun-me
      url-base: https://github.com/mozixun-me
  projects:
    - name: mozixun
      remote: mozixun-me
      revision: main
      import: app/west.yml
  self:
    path: config
```
